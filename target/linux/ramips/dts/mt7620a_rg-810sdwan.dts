#include "mt7620a_rg-810sdwan.dtsi"

/ {
	compatible = "rg-810sdwan", "rg-810sdwan", "ralink,mt7620a-soc";
	model = "Ruijei RG-810sdwan";
};

&flash0 {
	broken-flash-reset;
};

&firmware {
	reg = <0x50000 0x1fb0000>;
};
